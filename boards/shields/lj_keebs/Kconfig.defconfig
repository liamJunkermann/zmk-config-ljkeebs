## boards/shields/lj_keebs/Kconfig.defconfig
```kconfig
# Copyright (c) 2023 The ZMK Contributors
# SPDX-License-Identifier: MIT

if SHIELD_LJ_KEEBS_LEFT

config ZMK_KEYBOARD_NAME
    default "LJ KEEBS"

config ZMK_SPLIT_ROLE_CENTRAL
    default y

endif # SHIELD_LJ_KEEBS_LEFT

if SHIELD_LJ_KEEBS_LEFT || SHIELD_LJ_KEEBS_RIGHT

config ZMK_SPLIT
    default y

endif # SHIELD_LJ_KEEBS_LEFT || SHIELD_LJ_KEEBS_RIGHT
```

## config/boards/shields/lj_keebs/Kconfig.defconfig
```kconfig
if SHIELD_LJ_KEEBS_LEFT

# Name must be less than 16 characters long!
config ZMK_KEYBOARD_NAME
    default "LJ Keebs"

config ZMK_SPLIT_ROLE_CENTRAL
    default y

endif

if SHIELD_LJ_KEEBS_LEFT || SHIELD_LJ_KEEBS_RIGHT

config ZMK_SPLIT
    default y

endif
```

## config/boards/shields/lj_keebs/Kconfig.shield
```kconfig
# No whitespace after the comma or in your part name!
config SHIELD_LJ_KEEBS_LEFT
    def_bool $(shields_list_contains,lj_keebs_left)

# No whitespace after the comma or in your part name!
config SHIELD_LJ_KEEBS_RIGHT
    def_bool $(shields_list_contains,lj_keebs_right)
```
